## main/Kconfig.projbuild
```kconfig
menu "Application Configuration"

    choice IDLE_ANIM
        prompt "Idle LED Animation Style"
        default IDLE_ANIM_BREATHE
        help
            Determines the LED's Idle animation style.
        
        config IDLE_ANIM_RAINBOW
            bool "Rainbow"
        config IDLE_ANIM_BREATHE
            bool "Softly 'breathing' on and off"
    endchoice

    config BLINK_LED_RMT_CHANNEL
        int "RMT Channel"
        range 0 7
        default 0
        help
            Set the RMT peripheral channel.
            ESP32 RMT channel from 0 to 7
            ESP32-S2 RMT channel from 0 to 3
            ESP32-S3 RMT channel from 0 to 3
            ESP32-C3 RMT channel from 0 to 1

    config BLINK_GPIO
        int "Blink GPIO number"
        range 0 48
        default 8 if IDF_TARGET_ESP32C3 || IDF_TARGET_ESP32H2
        default 18 if IDF_TARGET_ESP32S2
        default 48 if IDF_TARGET_ESP32S3
        default 5
        help
            GPIO number (IOxx) to blink on and off or the RMT signal for the addressable LED.
            Some GPIOs are used for other purposes (flash connections, etc.) and cannot be used to blink.
    
    config INPUT_GPIO
        int "Morse Input GPIO number"
        range 0 48
        default 10
        help
            GPIO pin to take input on. Will be configured with an internal pull-up resistor;
            connect to ground to input (active low).

    config MORSE_UNIT_MS
        int "Morse Unit Length (ms)"
        range 1 9000
        default 150
        help
            Defines how long a single Morse unit should take in milliseconds.
            A dit/dot is one unit and a dah/dash is three.

    config REFRESH_MS
        int "Refresh Duration (ms)"
        range 1 3600000
        default 25
        help
            Define the refresh duration between an application loop in milliseconds.

endmenu
```
